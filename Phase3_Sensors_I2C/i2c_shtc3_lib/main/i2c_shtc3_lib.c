/**
 * @file    i2c_shtc3_lib.c
 * @brief   ESP32-C3 I2C Master Driver for the Sensirion SHTC3
 *          Temperature & Humidity Sensor using the ESP-IDF prebuilt
 *          i2c_master driver (driver/i2c_master.h).
 *
 * ==========================================================================
 * PROTOCOL OVERVIEW: I2C
 * ==========================================================================
 * I2C (Inter-Integrated Circuit) is a 2-wire synchronous serial bus:
 *   - SDA (Serial Data Line): carries data bits, addresses, and ACKs.
 *   - SCL (Serial Clock Line): generated by the master to synchronize all
 *                              devices on the bus.
 *
 * The bus is "Open-Drain": no device ever drives the wire HIGH.
 * Devices only pull it LOW. A shared pull-up resistor (on this board,
 * already soldered) holds the line HIGH when no device is pulling it down.
 * This prevents short circuits when multiple devices share the bus.
 *
 * Every transaction has the form:
 *   START | 7-bit ADDRESS | R/W bit | ACK | DATA... | STOP
 *
 * A NACK (Not-Acknowledge) means the device did not respond — either
 * the wrong address, the device is asleep, or a wiring problem.
 *
 * ==========================================================================
 * SENSOR: Sensirion SHTC3
 * ==========================================================================
 * - Fixed I2C Address: 0x70 (hardwired in silicon, cannot change)
 * - Uses 7-bit addressing
 * - Default state: SLEEP MODE (must send Wakeup command before measuring)
 * - Measurement command returns 6 bytes: T_MSB, T_LSB, T_CRC,
 *                                        H_MSB, H_LSB, H_CRC
 * - CRC-8 polynomial: 0x31, init: 0xFF
 *
 * I2C Pins on ESP32-C3-DevKit-RUST-1 (from board schematic):
 *   SDA = GPIO_NUM_10
 *   SCL = GPIO_NUM_8
 *
 * Datasheet: https://sensirion.com/media/documents/643F9C8E/63A5A436/Datasheet_SHTC3.pdf
 * Board Schematic: https://github.com/esp-rs/esp-rust-board
 *
 * ==========================================================================
 * BUILD NOTE
 * ==========================================================================
 * CMakeLists.txt must include `REQUIRES esp_driver_i2c` to link this driver.
 */

#include <stdio.h>
#include "driver/i2c_master.h"  // Modern ESP-IDF I2C Master API
                                 // (NOT the legacy i2c.h — that is deprecated)
#include "freertos/FreeRTOS.h"  // FreeRTOS core — needed for pdMS_TO_TICKS macro
#include "freertos/task.h"       // vTaskDelay() — suspends the FreeRTOS task
                                 // WITHOUT busy-looping (releases CPU to other tasks)


/**
 * @brief Verify a CRC-8 checksum using the Sensirion SHTC3 polynomial.
 *
 * The SHTC3 appends an 8-bit CRC checksum after every 2 data bytes.
 * This checksum is a mathematical fingerprint of those bytes. If even
 * one bit flipped during transmission (due to electrical noise), the
 * recalculated CRC will NOT match the one the sensor sent.
 *
 * Algorithm:  CRC-8 with polynomial 0x31 (x^8 + x^5 + x^4 + 1),
 *             initialized to 0xFF. (Datasheet Section 4.3)
 *
 * How it works:
 *   1. Start crc = 0xFF.
 *   2. XOR each data byte into crc.
 *   3. For each bit: if the highest bit of crc is 1, shift left and XOR
 *      with the polynomial 0x31. Otherwise just shift left.
 *   4. After processing all bytes, compare with the expected checksum.
 *
 * @param data              Array of exactly 2 bytes (MSB, LSB) to verify.
 * @param expected_checksum The CRC byte received from the sensor (data[2] or data[5]).
 * @return                  1 if the data is uncorrupted, 0 if CRC mismatch.
 */
uint8_t verify_crc(uint8_t data[2], uint8_t expected_checksum)
{
    uint8_t crc = 0xFF;  // Initialize to 0xFF as required by the SHTC3 spec

    for (int i = 0; i < 2; i++) {
        crc ^= data[i];  // XOR the current data byte into the running CRC

        // Process each of the 8 bits in this byte
        for (int bit = 8; bit > 0; --bit) {
            if (crc & 0x80) {
                // The highest bit is 1 — this is the "overflow" case.
                // Shift left (discard the MSB that fell off) and XOR
                // with the polynomial 0x31. This is the core CRC math.
                crc = (crc << 1) ^ 0x31;
            } else {
                // The highest bit is 0 — just shift left, no XOR needed.
                crc = (crc << 1);
            }
        }
    }

    // If our calculated fingerprint matches the sensor's, the data is valid.
    return (crc == expected_checksum) ? 1 : 0;
}


/**
 * @brief Application entry point. Called by the FreeRTOS main_task on boot.
 *
 * This function:
 *   1. Initializes the ESP32-C3's I2C hardware peripheral as a Master.
 *   2. Registers the SHTC3 sensor as a device on that bus.
 *   3. Enters an infinite loop that wakes the sensor, takes a measurement,
 *      verifies the CRC checksum, converts the raw data, and prints results.
 */
void app_main(void)
{
    // =========================================================================
    // STEP 1: Configure the I2C Master Bus (the two physical wires)
    // =========================================================================
    // i2c_master_bus_config_t describes the PHYSICAL hardware properties:
    // which GPIO Matrix routes to use, what clock, what glitch filter.
    // This is about the BUS itself, not any specific device on it.
    i2c_master_bus_config_t i2c_mst_config = {};

    // I2C peripheral port. The ESP32-C3 has only one hardware I2C controller.
    // Setting -1 means "auto-select" — the driver picks the available one.
    i2c_mst_config.i2c_port = -1;

    // SDA and SCL GPIO pins. These must match the board schematic!
    // The ESP32-C3 GPIO Matrix routes the I2C signals to these physical pins.
    // (From esp-rs/esp-rust-board schematic: SDA=GPIO10, SCL=GPIO8)
    i2c_mst_config.sda_io_num = GPIO_NUM_10;
    i2c_mst_config.scl_io_num = GPIO_NUM_8;

    // Clock source for the I2C peripheral. I2C_CLK_SRC_DEFAULT uses the
    // APB (Advanced Peripheral Bus) clock — the standard choice for almost
    // all I2C applications on the ESP32-C3.
    i2c_mst_config.clk_source = I2C_CLK_SRC_DEFAULT;

    // Glitch filter duration (in APB clock cycles). Electrical spikes shorter
    // than 7 cycles are ignored as noise. Value 7 is the Espressif-recommended
    // default for standard environments.
    i2c_mst_config.glitch_ignore_cnt = 7;

    // Initialize the I2C hardware and get back a "bus handle" — an opaque
    // pointer that represents this configured bus instance. We pass this
    // handle to all future bus-level operations.
    // ESP_ERROR_CHECK() aborts with a descriptive error if this fails.
    i2c_master_bus_handle_t bus_handle;
    ESP_ERROR_CHECK(i2c_new_master_bus(&i2c_mst_config, &bus_handle));


    // =========================================================================
    // STEP 2: Register the SHTC3 Sensor as a Device on the Bus
    // =========================================================================
    // i2c_device_config_t describes ONE specific peripheral device —
    // its I2C address and the speed at which to communicate with it.
    // No I2C transaction happens here. This just stores the info for later.
    i2c_device_config_t i2c_dev_config = {};

    // The SHTC3 uses the standard 7-bit addressing scheme (not 10-bit).
    // Almost all I2C sensors use 7-bit addresses.
    i2c_dev_config.dev_addr_length = I2C_ADDR_BIT_LEN_7;

    // The SHTC3's I2C address is 0x70 — hardwired in its silicon by Sensirion.
    // This cannot be changed. Every SHTC3 ever made has this address.
    // In 7-bit form: 0x70 = 0b 111 0000
    i2c_dev_config.device_address = 0x70;

    // Communication speed in Hz. 100,000 Hz = 100 kHz = I2C Standard Mode.
    // The SHTC3 supports up to 1 MHz, but 100 kHz is the most
    // universally reliable speed and more than sufficient for 1-second readings.
    i2c_dev_config.scl_speed_hz = 100000;

    // Add the SHTC3 to the bus and receive a "device handle" —
    // an opaque pointer specifically for talking to this device.
    // All transmit/receive calls use this device handle, not the bus handle.
    i2c_master_dev_handle_t dev_handle;
    ESP_ERROR_CHECK(i2c_master_bus_add_device(bus_handle, &i2c_dev_config, &dev_handle));


    // =========================================================================
    // STEP 3: Main Application Loop — Read Sensor Every Second
    // =========================================================================
    while (1) {

        // --- 3a. Wake Up the Sensor ---
        // The SHTC3 is in Sleep Mode by default (~0.3µA). Before any
        // measurement, we MUST send the 2-byte Wake-Up command: 0x35 0x17.
        // (SHTC3 Datasheet, Section 5, Table 8)
        uint8_t cmd[2] = {0x35, 0x17};
        // This transmit sends: START | 0x70+WRITE | ACK | 0x35 | ACK | 0x17 | ACK | STOP
        // The pdMS_TO_TICKS(100) is a BUS TIMEOUT (not a delay!).
        // It means: "if the bus is stuck, give up after 100ms." Under normal
        // operation, this call returns in ~2 microseconds.
        ESP_ERROR_CHECK(i2c_master_transmit(dev_handle, cmd, sizeof(cmd), pdMS_TO_TICKS(100)));

        // Explicit FreeRTOS delay: suspend THIS task for 10 milliseconds.
        // This is NOT a busy-wait — the CPU is free to run other FreeRTOS tasks.
        // We NEED this because the SHTC3 requires time to power on its
        // internal circuits. Without this delay, the next command will arrive
        // before the sensor is awake and it will send a NACK (no response),
        // causing ESP_ERROR_CHECK to abort with ESP_ERR_INVALID_RESPONSE.
        vTaskDelay(pdMS_TO_TICKS(10));


        // --- 3b. Send the Measurement Command ---
        // Command 0x78 0x66 = "Measure in Normal Mode, No Clock Stretching,
        // Temperature First" (Datasheet, Section 5, Table 9).
        // "Normal Mode" = full ADC resolution for best accuracy (±0.2°C).
        // "No Clock Stretching" = sensor does NOT hold SCL low during measurement.
        //   We handle the wait time explicitly with vTaskDelay below.
        // "Temperature First" = the 6-byte response is: T_MSB, T_LSB, T_CRC,
        //   H_MSB, H_LSB, H_CRC (temperature bytes come before humidity bytes).
        cmd[0] = 0x78;
        cmd[1] = 0x66;
        ESP_ERROR_CHECK(i2c_master_transmit(dev_handle, cmd, sizeof(cmd), pdMS_TO_TICKS(100)));

        // Wait for the physical measurement to complete.
        // The SHTC3's internal ADC takes up to 12.1ms in Normal Mode
        // (Datasheet, Table 3). We wait 20ms for safety margin.
        // A real battery-powered design would use the minimum to save power.
        vTaskDelay(pdMS_TO_TICKS(20));


        // --- 3c. Read the 6 Data Bytes ---
        // The sensor has finished measuring and is holding the result.
        // We read exactly 6 bytes in one I2C read transaction.
        //
        // Byte layout (in the order received):
        //   data[0] = Temperature MSB  (Most Significant Byte — upper 8 bits)
        //   data[1] = Temperature LSB  (Least Significant Byte — lower 8 bits)
        //   data[2] = Temperature CRC  (checksum for data[0] and data[1])
        //   data[3] = Humidity MSB
        //   data[4] = Humidity LSB
        //   data[5] = Humidity CRC     (checksum for data[3] and data[4])
        uint8_t data[6] = {0};  // Initialize all bytes to 0 for safety
        ESP_ERROR_CHECK(i2c_master_receive(dev_handle, data, sizeof(data), pdMS_TO_TICKS(100)));


        // --- 3d. Verify and Calculate Temperature ---
        // Extract the 2 temperature bytes into a small array for CRC input.
        uint8_t temp_bytes[2] = {data[0], data[1]};

        if (verify_crc(temp_bytes, data[2])) {
            // CRC PASSED — the temperature bytes are uncorrupted.

            // Reassemble the two 8-bit bytes into one 16-bit raw value.
            // The SHTC3 uses Big-Endian (MSB first) byte order.
            //
            // data[0] << 8  : Left-shifts data[0] by 8 bits, placing it in
            //                 the upper byte of the 16-bit integer.
            // | data[1]     : Bitwise OR places data[1] in the lower byte.
            //
            // Example: data[0]=0x76, data[1]=0xE2
            //   0x76 << 8 = 0x7600
            //   0x7600 | 0xE2 = 0x76E2 = 30434
            uint16_t raw_temp = (data[0] << 8) | data[1];

            // Apply the SHTC3 temperature conversion formula (Datasheet 5.4):
            //   T[°C] = -45 + 175 × (raw_temp / 65535)
            //
            // At raw_temp=0:     T = -45°C  (minimum range)
            // At raw_temp=65535: T = +130°C (maximum range)
            //
            // IMPORTANT: Cast raw_temp to float BEFORE dividing!
            // Integer division in C truncates (30434 / 65535 = 0, not 0.46...).
            float temp_c = -45.0 + (175.0 * ((float)raw_temp / 65535.0));

            // %.2f prints the float with exactly 2 decimal places.
            // NEVER use %d for floats — %d treats the IEEE-754 float bits
            // as an integer and prints garbage values.
            printf("Temperature: %.2f °C \n", temp_c);
        } else {
            // CRC FAILED — at least one bit was corrupted during transmission.
            // Do NOT use this reading. In production code, you might retry.
            printf("ERROR: Temperature CRC Failed!\n");
        }


        // --- 3e. Verify and Calculate Humidity ---
        // Same process as temperature, but using bytes 3, 4, and 5.
        uint8_t humid_bytes[2] = {data[3], data[4]};

        if (verify_crc(humid_bytes, data[5])) {
            // Reassemble the raw 16-bit humidity value.
            uint16_t raw_humid = (data[3] << 8) | data[4];

            // Apply the SHTC3 humidity conversion formula (Datasheet 5.4):
            //   RH[%] = 100 × (raw_humid / 65535)
            //
            // At raw_humid=0:     RH = 0%   (bone dry)
            // At raw_humid=65535: RH = 100% (fully saturated)
            float humid_rh = 100.0 * ((float)raw_humid / 65535.0);

            // %% in printf prints a literal '%' character.
            printf("Humidity: %.2f %% \n", humid_rh);
        } else {
            printf("ERROR: Humidity CRC Failed!\n");
        }

        // Visual separator in the serial monitor output.
        printf("------------------------------------\n");

        // Wait 1 second before the next reading.
        // This suspends the FreeRTOS task (releases CPU to other tasks).
        vTaskDelay(pdMS_TO_TICKS(1000));
    }

    // This line is unreachable (while(1) never exits), but it is good
    // practice to have a return at the end of app_main for clarity.
    return;
}
